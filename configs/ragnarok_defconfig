## configs/ragnarok_defconfig
```kconfig
BR2_aarch64=y
BR2_JLEVEL=16
BR2_TOOLCHAIN_BUILDROOT_GLIBC=y
BR2_KERNEL_HEADERS_5_16=y
BR2_BINUTILS_VERSION_2_38_X=y
BR2_GCC_VERSION_11_X=y
BR2_TOOLCHAIN_BUILDROOT_CXX=y
BR2_ROOTFS_DEVICE_CREATION_DYNAMIC_EUDEV=y
BR2_PACKAGE_ALSA_UTILS=y
BR2_PACKAGE_ALSA_UTILS_ALSAUCM=y
BR2_PACKAGE_ALSA_UTILS_AMIXER=y
BR2_PACKAGE_ALSA_UTILS_SPEAKER_TEST=y
BR2_PACKAGE_GSTREAMER1=y
BR2_PACKAGE_GST1_PLUGINS_BASE_PLUGIN_AUDIOMIXER=y
BR2_PACKAGE_GST1_PLUGINS_BASE_PLUGIN_VIDEOTESTSRC=y
BR2_PACKAGE_GST1_PLUGINS_BASE_PLUGIN_VIDEORATE=y
BR2_PACKAGE_GST1_PLUGINS_GOOD=y
BR2_PACKAGE_GST1_PLUGINS_GOOD_PLUGIN_AUTODETECT=y
BR2_PACKAGE_GST1_PLUGINS_GOOD_PLUGIN_MATROSKA=y
BR2_PACKAGE_GST1_PLUGINS_BAD=y
BR2_PACKAGE_GST1_PLUGINS_BAD_PLUGIN_KMS=y
BR2_PACKAGE_GST1_PLUGINS_BAD_PLUGIN_V4L2CODECS=y
BR2_PACKAGE_LIBERATION=y
BR2_PACKAGE_MESA3D_DEMOS=y
BR2_PACKAGE_MESA3D=y
BR2_PACKAGE_MESA3D_GALLIUM_DRIVER_PANFROST=y
BR2_PACKAGE_MESA3D_OPENGL_EGL=y
BR2_PACKAGE_MESA3D_OPENGL_ES=y
BR2_PACKAGE_SDL2=y
BR2_PACKAGE_SDL2_KMSDRM=y
BR2_PACKAGE_SDL2_OPENGLES=y
BR2_PACKAGE_SDL2_GFX=y
BR2_PACKAGE_SDL2_IMAGE=y
BR2_PACKAGE_SDL2_MIXER=y
BR2_PACKAGE_SDL2_NET=y
BR2_PACKAGE_SDL2_TTF=y
BR2_PACKAGE_WESTON=y
# BR2_PACKAGE_WESTON_SHELL_DESKTOP is not set
# BR2_PACKAGE_WESTON_SHELL_FULLSCREEN is not set
# BR2_PACKAGE_WESTON_SHELL_IVI is not set
BR2_PACKAGE_WESTON_DEMO_CLIENTS=y
BR2_PACKAGE_EVTEST=y
BR2_PACKAGE_LIBV4L=y
BR2_PACKAGE_LIBV4L_UTILS=y
BR2_PACKAGE_RINPUTER2=y
BR2_PACKAGE_RTOYBOX=y
```

## package/datamounter/Config.in
```kconfig
config BR2_PACKAGE_DATAMOUNTER
	bool "Datamounter"
	help
	  Ragnarok data partition mount script
```

## package/mednafen/Config.in
```kconfig
config BR2_PACKAGE_MEDNAFEN
	bool "mednafen"
	help
	  Emulator for multiple systems
```

## package/rtoybox/Config.in
```kconfig
config BR2_PACKAGE_RTOYBOX
	bool "Rtoybox"
	help
	  A set of programs to make ragnarok2 usable
```
